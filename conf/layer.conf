## conf/machine/imx8qm-var-som.conf
```bitbake
#@TYPE: Machine
#@NAME: Variscite VAR-SOM-MX8
#@SOC: i.MX8QM
#@DESCRIPTION: Machine configuration for Variscite VAR-SOM-MX8
#@MAINTAINER: Felix Radensky <felix.r@variscite.com>
#
# http://www.variscite.com

MACHINEOVERRIDES =. "mx8:mx8qm:"

require conf/machine/include/imx-base.inc
require conf/machine/include/tune-cortexa72-cortexa53.inc

require variscite.inc

KERNEL_DEVICETREE = " \
	freescale/imx8qm-var-som-dp.dtb \
	freescale/imx8qm-var-som-hdmi.dtb \
	freescale/imx8qm-var-som-lvds.dtb \
	freescale/imx8qm-var-spear-dp.dtb \
	freescale/imx8qm-var-spear-hdmi.dtb \
	freescale/imx8qm-var-spear-lvds.dtb \
"

UBOOT_SUFFIX = "bin"
UBOOT_CONFIG ??= "sd"
UBOOT_CONFIG[sd] = "imx8qm_var_som_defconfig,sdcard"

# Set U-Boot DTB
UBOOT_DTB_NAME = "fsl-imx8qm-var-som.dtb"

# Set imx-mkimage boot target
IMXBOOT_TARGETS = "flash"

SERIAL_CONSOLES = "115200;ttyLP0"

IMAGE_BOOTLOADER = "imx-boot"

ROOTFS_SIZE = "3700"
LOADADDR = ""
UBOOT_MAKE_TARGET = "u-boot.bin"
IMX_BOOT_SEEK = "32"

IMAGE_BOOTFILES_DEPENDS += "firmware-imx:do_deploy"
IMAGE_BOOTFILES += "hdmitxfw.bin hdmirxfw.bin dpfw.bin"

MACHINE_EXTRA_RDEPENDS += " firmware-imx-hdmi"
```

## conf/machine/imx8qxp-var-som.conf
```bitbake
#@TYPE: Machine
#@NAME: Variscite VAR-SOM-MX8X
#@SOC: i.MX8QXP
#@DESCRIPTION: Machine configuration for Variscite VAR-SOM-MX8X
#@MAINTAINER: Felix Radensky <felix.r@variscite.com>
#
# http://www.variscite.com

MACHINEOVERRIDES =. "mx8qxpc0:"

require conf/machine/imx8qxpb0-var-som.conf
```

## conf/machine/imx8qxpb0-var-som.conf
```bitbake
#@TYPE: Machine
#@NAME: Variscite VAR-SOM-MX8X
#@SOC: i.MX8QXP
#@DESCRIPTION: Machine configuration for Variscite VAR-SOM-MX8X
#@MAINTAINER: Felix Radensky <felix.r@variscite.com>
#
# http://www.variscite.com

MACHINEOVERRIDES =. "mx8:mx8x:mx8qxp:"
require conf/machine/include/imx-base.inc
require conf/machine/include/tune-cortexa35.inc

require variscite.inc
require variscite_bcm43xx.inc

KERNEL_DEVICETREE = " \
	freescale/imx8qxp-var-som-symphony-sd.dtb \
	freescale/imx8qxp-var-som-symphony-wifi.dtb \
	freescale/imx8qxp-var-som-symphony-wifi-m4.dtb \
	freescale/imx8qxp-var-som-symphony-sd-m4.dtb \
"

SPL_BINARY = "spl/u-boot-spl.bin"
UBOOT_SUFFIX = "bin"
UBOOT_CONFIG ??= "sd"
UBOOT_CONFIG[sd] = "imx8qxp_var_som_defconfig,sdcard"

# Set U-Boot DTB
UBOOT_DTB_NAME = "fsl-imx8qxp-var-som-symphony.dtb"

# Set imx-mkimage boot target
IMXBOOT_TARGETS = "flash_spl"

SERIAL_CONSOLES = "115200;ttyLP3"

IMAGE_BOOTLOADER = "imx-boot"

ROOTFS_SIZE = "3700"
LOADADDR = ""
UBOOT_MAKE_TARGET = "u-boot.bin"
IMX_BOOT_SEEK = "32"
```

## conf/machine/include/variscite-mirrors.inc
```bitbake
MIRRORS += "\
    git://anonscm.debian.org/.*   git://anonscm.debian.org/git/PATH;protocol=https \n \
    git://git.gnome.org/.*        git://git.gnome.org/browse/PATH;protocol=https \n \
    git://git.savannah.gnu.org/.* git://git.savannah.gnu.org/git/PATH;protocol=https \n \
    git://git.yoctoproject.org/.* git://git.yoctoproject.org/git/PATH;protocol=https \n \
    git://.*/.*                   git://HOST/PATH;protocol=https \n \
    git://source.codeaurora.org/external/imx/ git://github.com/nxp-imx/ \n \
    https://source.codeaurora.org/external/imx/ https://github.com/nxp-imx/ \n \
    http://source.codeaurora.org/external/imx/ http://github.com/nxp-imx/ \n \
    gitsm://source.codeaurora.org/external/imx/ gitsm://github.com/nxp-imx/ \n \
"
```

## conf/machine/include/variscite.inc
```bitbake
MACHINE_FEATURES += " pci bluetooth touchscreen wifi"

# UBIFS for Variscite 0.5GB NAND flash
# erase block size of 128KiB
export MKUBIFS_ARGS_128kbpeb = " -m 2048 -e 124KiB -c 3965 "
export UBINIZE_ARGS_128kbpeb = " -m 2048 -p 128KiB -s 2048 "

# erase block size of 256KiB
export MKUBIFS_ARGS_256kbpeb = " -m 4096 -e 248KiB -c 2000 "
export UBINIZE_ARGS_256kbpeb = " -m 4096 -p 256KiB -s 4096 "

# UBIFS for Variscite 1GB NAND flash
# erase block size of 128KiB
#MKUBIFS_ARGS = " -m 2048 -e 124KiB -c 7855 "
#UBINIZE_ARGS = " -m 2048 -p 128KiB -s 2048 "

# erase block size of 512KiB
#MKUBIFS_ARGS = " -m 4096 -e 504KiB -c 2000 "
#UBINIZE_ARGS = " -m 4096 -p 512KiB -s 4096 "

MULTIUBI_BUILD ?= "128kbpeb 256kbpeb"

UBI_VOLNAME  = "rootfs"

# Variscite BSP default providers
PREFERRED_PROVIDER_virtual/kernel ?= "linux-variscite"
PREFERRED_VERSION_linux-variscite = "4.9.11"

PREFERRED_PROVIDER_u-boot = "u-boot-variscite"
PREFERRED_PROVIDER_virtual/bootloader = "u-boot-variscite"
PREFERRED_PROVIDER_u-boot-fw-utils = "u-boot-fw-utils"

PREFERRED_PROVIDER_wpa-supplicant-cli = "wpa-supplicant"
PREFERRED_PROVIDER_wpa-supplicant-passphrase = "wpa-supplicant"
PREFERRED_PROVIDER_wpa-supplicant = "wpa-supplicant"

MACHINE_EXTRA_RDEPENDS += " \
			   crda \
			   bridge-utils \
			   connman \
			   hostapd \
			   imx-kobs \
			   iw \
			   kernel-modules \
			   packagegroup-tools-bluetooth \
			   pm-utils \
			   rng-tools \
			   hdparm \
			   gptfdisk \
			   tslib-calibrate \
			   tslib-tests \
			   u-boot-fw-utils \
			   u-boot-splash \
			   wpa-supplicant \
			   ${@bb.utils.contains('DISTRO_FEATURES', 'x11', "x11vnc", "", d)} \
			   "

# Packages added to all images (including core-image-minimal)
IMAGE_INSTALL_append = " \
        fsl-rc-local \
"

BBMASK_prepend = "fsl-image-mfgtool-initramfs "
BBMASK += "meta-freescale/dynamic-layers/browser-layer/recipes-browser/chromium"

WKS_FILE = "imx-uboot-spl-bootpart.wks"
IMAGE_FSTYPES += "tar.gz multiubi"

# do multiubi last
IMAGE_TYPEDEP_multiubi += "${IMAGE_FSTYPES}"
IMAGE_TYPEDEP_multiubi_remove = "multiubi"

multiubi_mkfs_prepend() {
	# Update PEB size in fw_env.config (u-boot-fw-utils)
	if [ -f ${IMAGE_ROOTFS}${sysconfdir}/fw_env.config ]; then
		# Get PEB from UBINIZE_ARGS
		MTD_ERASESIZE=`echo "$2" | tr ' =' '\n' | awk '/^-p$|^--peb-size$/{getline; print}'`
		# Convert to bytes (decimal)
		MTD_ERASESIZE=`echo $MTD_ERASESIZE | sed 's/MiB/ * 1024 KiB/;s/KiB/ * 1024/' | bc`
		# Convert to hexadecimal
		MTD_ERASESIZE=`printf 0x%x $MTD_ERASESIZE`

		awk -i inplace -v n=4 -v ERASESIZE="${MTD_ERASESIZE}" '/\/dev\/mtd/{$(n)=ERASESIZE}1' ${IMAGE_ROOTFS}${sysconfdir}/fw_env.config
	fi
}
```

## conf/machine/var-som-mx6.conf
```bitbake
#@TYPE: Machine
#@NAME: Variscite VAR-SOM-MX6
#@SOC: i.MX6Q/D/DL/S
#@DESCRIPTION: Machine configuration for Variscite VAR-SOM-MX6 VAR-SOM-SOLO/DUAL DART-MX6
#@MAINTAINER: Eran Matityahu <eran.m@variscite.com>
#
# http://www.variscite.com

MACHINEOVERRIDES =. "mx6:mx6dl:mx6q:"
require conf/machine/include/imx-base.inc
require conf/machine/include/tune-cortexa9.inc

require variscite.inc
require variscite_ubi.inc

SERIAL_CONSOLES = "115200;ttymxc0"


KERNEL_IMAGETYPE = "uImage"

KERNEL_DEVICETREE = " \
		     imx6dl-var-som-cap.dtb \
		     imx6dl-var-som-res.dtb \
		     imx6dl-var-som-solo-cap.dtb \
		     imx6dl-var-som-solo-res.dtb \
		     imx6dl-var-som-solo-vsc.dtb \
		     imx6dl-var-som-vsc.dtb \
		     imx6q-var-dart.dtb \
		     imx6q-var-som-cap.dtb \
		     imx6q-var-som-res.dtb \
		     imx6q-var-som-vsc.dtb \
		     imx6qp-var-som-cap.dtb \
		     imx6qp-var-som-res.dtb \
		     imx6qp-var-som-vsc.dtb \
		     "

SOC_DEFAULT_WKS_FILE = "imx-uboot-spl-bootpart.wks.in"

IMAGE_BOOT_FILES = " \
		    ${KERNEL_IMAGETYPE} \
		    ${KERNEL_DEVICETREE} \
		    "

UBOOT_MAKE_TARGET = ""
SPL_BINARY          = "SPL"
UBOOT_SUFFIX        = "img"
UBOOT_CONFIG ??= "nand sd "
# The above order matters. The last one will be also called u-boot-${MACHINE} and will be used to create the sdcard.
UBOOT_CONFIG[sd] = "mx6var_som_sd_config,sdcard"
UBOOT_CONFIG[nand] = "mx6var_som_nand_config,ubifs"

MACHINE_EXTRA_RDEPENDS += " \
			   linux-firmware-wl18xx \
			   wl18xx-calibrator \
			   wl18xx-target-scripts \
			   wlconf \
			   "
```

## conf/machine/variscite.inc
```bitbake
INHERIT += "image-buildinfo"

MACHINE_FEATURES += " pci bluetooth wifi"

IMX_DEFAULT_BSP = "nxp"

USE_VT = "0"

KERNEL_IMAGETYPE_mx8 = "Image.gz"

SOC_DEFAULT_WKS_FILE_mx8 = "imx-imx-boot-bootpart1.wks.in"

DEFAULTTUNE_mx8mm  ?= "cortexa53-crypto"
DEFAULTTUNE_mx8mn  ?= "cortexa53-crypto"
DEFAULTTUNE_mx8mq  ?= "cortexa53-crypto"
DEFAULTTUNE_mx8qxp ?= "cortexa35-crypto"
DEFAULTTUNE_mx8qm ?= "cortexa72-cortexa53-crypto"

# Variscite BSP default providers
PREFERRED_PROVIDER_u-boot = "u-boot-variscite"
PREFERRED_PROVIDER_u-boot-fw-utils = "u-boot-fw-utils"
PREFERRED_PROVIDER_virtual/bootloader = "u-boot-variscite"
PREFERRED_PROVIDER_virtual/kernel = "linux-variscite"

# Use i.MX Gstreamer Version
MACHINE_GSTREAMER_1_0_PLUGIN_mx8 = "imx-gst1.0-plugin"
PREFERRED_VERSION_gstreamer1.0_mx8 ?= "1.16.2.imx"
PREFERRED_VERSION_gstreamer1.0-plugins-base_mx8 ?= "1.16.2.imx"
PREFERRED_VERSION_gstreamer1.0-plugins-good_mx8 ?= "1.16.3.imx"
PREFERRED_VERSION_gstreamer1.0-plugins-bad_mx8 ?= "1.16.3.imx"
PREFERRED_VERSION_gstreamer1.0-libav_mx8 ?= "1.16.0"

# Add VPU and Cortex M4/M7 firmware
MACHINE_FIRMWARE_append_mx8 = " \
	firmware-imx-vpu-imx8 \
	freertos-variscite \
	"

MACHINE_EXTRA_RDEPENDS += " \
	gptfdisk \
	hostapd \
	hdparm \
	imx-kobs \
	iw \
	kernel-modules \
	kmod \
	${@bb.utils.contains('DISTRO', 'b2qt', '', \
           bb.utils.contains('DISTRO_FEATURES', 'wayland', 'networkmanager networkmanager-nmcli', \
                                                       '', d), d)} \
	packagegroup-tools-bluetooth \
	bluez-alsa \
	pm-utils \
	rng-tools \
	wpa-supplicant \
	wireless-regdb-static \
	u-boot-fw-utils \
	u-boot-splash \
"

# Packages added to all images (including core-image-minimal)
IMAGE_INSTALL_append_mx8 = " \
	kernel-image \
	kernel-devicetree \
"

IMAGE_FSTYPES = "tar.gz wic.gz"

# Wayland based distros add systemd to DISTRO_FEATURES
# Remove sysvinit or systemd based on DISTRO_FEATURES to avoid conflicts
DISTRO_FEATURES_BACKFILL_CONSIDERED_append = "${@bb.utils.contains('DISTRO_FEATURES', 'systemd', ' sysvinit', '', d)}"
DISTRO_FEATURES_BACKFILL_CONSIDERED_append = "${@bb.utils.contains('DISTRO_FEATURES', 'sysvinit', ' systemd', '', d)}"

# Use bluez-alsa instead of pulseaudio
DISTRO_FEATURES_BACKFILL_CONSIDERED_append = " pulseaudio"
```

## conf/machine/variscite_bcm43xx.inc
```bitbake
MACHINE_EXTRA_RDEPENDS += " \
	bcm43xx-utils \
	brcm-patchram-plus \
	linux-firmware-bcm4339 \
	linux-firmware-bcm43430 \
"
```

## conf/machine/variscite_ubi.inc
```bitbake
# UBIFS for Variscite 0.5GB NAND flash
# erase block size of 128KiB
export MKUBIFS_ARGS_128kbpeb = " -m 2048 -e 124KiB -c 3965 "
export UBINIZE_ARGS_128kbpeb = " -m 2048 -p 128KiB -s 2048 "

# erase block size of 256KiB
export MKUBIFS_ARGS_256kbpeb = " -m 4096 -e 248KiB -c 2000 "
export UBINIZE_ARGS_256kbpeb = " -m 4096 -p 256KiB -s 4096 "

# UBIFS for Variscite 1GB NAND flash
# erase block size of 128KiB
#MKUBIFS_ARGS = " -m 2048 -e 124KiB -c 7855 "
#UBINIZE_ARGS = " -m 2048 -p 128KiB -s 2048 "

# erase block size of 512KiB
#MKUBIFS_ARGS = " -m 4096 -e 504KiB -c 2000 "
#UBINIZE_ARGS = " -m 4096 -p 512KiB -s 4096 "

MULTIUBI_BUILD ?= "128kbpeb 256kbpeb"

UBI_VOLNAME  = "rootfs"

IMAGE_FSTYPES = "tar.gz multiubi wic.gz"
```
