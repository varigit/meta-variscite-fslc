## conf/layer.conf
```bitbake
# We have a conf and classes directory, add to BBPATH
BBPATH .= ":${LAYERDIR}"

# We have a packages directory, add to BBFILES
BBFILES += "${LAYERDIR}/recipes-*/*/*.bb \
            ${LAYERDIR}/recipes-*/*/*.bbappend"

BBFILE_COLLECTIONS += "variscite-fslc"
BBFILE_PATTERN_variscite-fslc := "^${LAYERDIR}/"
BBFILE_PRIORITY_variscite-fslc = "9"

LAYERSERIES_COMPAT_variscite-fslc = "dunfell"

BBFILES_DYNAMIC += " \
    qt5-layer:${LAYERDIR}/dynamic-layers/qt5-layer/*/*/*.bb \
    qt5-layer:${LAYERDIR}/dynamic-layers/qt5-layer/*/*/*.bbappend \
    \
    swupdate:${LAYERDIR}/dynamic-layers/swupdate/*.bb \
    swupdate:${LAYERDIR}/dynamic-layers/swupdate/*.bbappend \
    \
    virtualization-layer:${LAYERDIR}/dynamic-layers/virtualization/*/*/*.bb \
    virtualization-layer:${LAYERDIR}/dynamic-layers/virtualization/*/*/*.bbappend \
    \
    freescale-distro:${LAYERDIR}/dynamic-layers/freescale-distro/*/*/*.bb \
    freescale-distro:${LAYERDIR}/dynamic-layers/freescale-distro/*/*/*.bbappend \
"
```

## conf/machine/imx6ul-var-dart.conf
```bitbake
#@TYPE: Machine
#@NAME: Variscite DART-6UL
#@SOC: i.MX6UL
#@DESCRIPTION: Machine configuration for Variscite DART-6UL
#@MAINTAINER: Eran Matityahu <eran.m@variscite.com>
#
# http://www.variscite.com

MACHINEOVERRIDES =. "mx6:mx6ul:"
require conf/machine/include/imx-base.inc
require conf/machine/include/tune-cortexa7.inc

require variscite.inc
require variscite_ubi.inc

SERIAL_CONSOLES = "115200;ttymxc0"


KERNEL_IMAGETYPE = "zImage"

KERNEL_DEVICETREE = " \
		     imx6ull-var-dart-6ulcustomboard-emmc-sd-card.dtb \
		     imx6ull-var-dart-6ulcustomboard-emmc-wifi.dtb \
		     imx6ull-var-dart-6ulcustomboard-nand-sd-card.dtb \
		     imx6ull-var-dart-6ulcustomboard-nand-wifi.dtb \
		     imx6ull-var-som-concerto-board-emmc-sd-card.dtb \
		     imx6ull-var-som-concerto-board-emmc-wifi.dtb \
		     imx6ull-var-som-concerto-board-nand-sd-card.dtb \
		     imx6ull-var-som-concerto-board-nand-wifi.dtb \
		     imx6ull-var-som-symphony-board-emmc-sd-card.dtb \
		     imx6ull-var-som-symphony-board-emmc-wifi.dtb \
		     imx6ull-var-som-symphony-board-nand-sd-card.dtb \
		     imx6ull-var-som-symphony-board-nand-wifi.dtb \
		     imx6ul-var-dart-6ulcustomboard-emmc-sd-card.dtb \
		     imx6ul-var-dart-6ulcustomboard-emmc-wifi.dtb \
		     imx6ul-var-dart-6ulcustomboard-nand-sd-card.dtb \
		     imx6ul-var-dart-6ulcustomboard-nand-wifi.dtb \
		     imx6ul-var-som-concerto-board-emmc-sd-card.dtb \
		     imx6ul-var-som-concerto-board-emmc-wifi.dtb \
		     imx6ul-var-som-concerto-board-nand-sd-card.dtb \
		     imx6ul-var-som-concerto-board-nand-wifi.dtb \
		     imx6ul-var-som-symphony-board-emmc-sd-card.dtb \
		     imx6ul-var-som-symphony-board-emmc-wifi.dtb \
		     imx6ul-var-som-symphony-board-nand-sd-card.dtb \
		     imx6ul-var-som-symphony-board-nand-wifi.dtb \
		     imx6ulz-var-dart-6ulcustomboard-emmc-sd-card.dtb \
		     imx6ulz-var-dart-6ulcustomboard-emmc-wifi.dtb \
		     imx6ulz-var-dart-6ulcustomboard-nand-sd-card.dtb \
		     imx6ulz-var-dart-6ulcustomboard-nand-wifi.dtb \
		     imx6ulz-var-som-concerto-board-emmc-sd-card.dtb \
		     imx6ulz-var-som-concerto-board-emmc-wifi.dtb \
		     imx6ulz-var-som-concerto-board-nand-sd-card.dtb \
		     imx6ulz-var-som-concerto-board-nand-wifi.dtb \
		     imx6ulz-var-som-symphony-board-emmc-sd-card.dtb \
		     imx6ulz-var-som-symphony-board-emmc-wifi.dtb \
		     imx6ulz-var-som-symphony-board-nand-sd-card.dtb \
		     imx6ulz-var-som-symphony-board-nand-wifi.dtb \
		     "

SOC_DEFAULT_WKS_FILE = "imx-uboot-spl-bootpart.wks.in"

IMAGE_BOOT_FILES = " \
    ${KERNEL_IMAGETYPE} \
    ${KERNEL_DEVICETREE} \
	"

UBOOT_MAKE_TARGET = ""
SPL_BINARY = "SPL"
UBOOT_SUFFIX = "img"
UBOOT_CONFIG ??= "nand sd "
# The above order matters. The last one will be also called u-boot-${MACHINE} and will be used to create the sdcard.
UBOOT_CONFIG[sd] = "mx6ul_var_dart_mmc_defconfig,sdcard"
UBOOT_CONFIG[nand] = "mx6ul_var_dart_nand_defconfig,ubifs"

MACHINE_FIRMWARE_append = " linux-firmware-imx-sdma-imx6q"
```

## conf/machine/imx7-var-som.conf
```bitbake
#@TYPE: Machine
#@NAME: Variscite VAR-SOM-MX7
#@SOC: i.MX7D
#@DESCRIPTION: Machine configuration for Variscite VAR-SOM-MX7
#@MAINTAINER: Eran Matityahu <eran.m@variscite.com>
#
# http://www.variscite.com

MACHINEOVERRIDES =. "mx7:mx7d:"
require conf/machine/include/imx-base.inc
require conf/machine/include/tune-cortexa7.inc

require variscite.inc
require variscite_bcm43xx.inc
require variscite_ubi.inc

SERIAL_CONSOLES = "115200;ttymxc0"


KERNEL_IMAGETYPE = "zImage"

KERNEL_DEVICETREE = " \
		     imx7d-var-som-emmc.dtb \
		     imx7d-var-som-nand.dtb \
		     imx7d-var-som-emmc-m4.dtb \
		     imx7d-var-som-nand-m4.dtb \
		     "
SOC_DEFAULT_WKS_FILE = "imx-uboot-spl-bootpart.wks.in"

IMAGE_BOOT_FILES = " \
    ${KERNEL_IMAGETYPE} \
    ${KERNEL_DEVICETREE} \
	"

UBOOT_MAKE_TARGET = ""
SPL_BINARY = "SPL"
UBOOT_SUFFIX = "img"
UBOOT_CONFIG ??= "nand sd "
# The above order matters. The last one will be also called u-boot-${MACHINE} and will be used to create the sdcard.
UBOOT_CONFIG[sd] = "mx7dvar_som_defconfig,sdcard"
UBOOT_CONFIG[nand] = "mx7dvar_som_nand_defconfig,ubifs"

MACHINE_FIRMWARE_append = " linux-firmware-imx-sdma-imx6q"
```

## conf/machine/imx8m-var-dart.conf
```bitbake
#@TYPE: Machine
#@NAME: Variscite DART-MX8M
#@SOC: i.MX8MQ
#@DESCRIPTION: Machine configuration for Variscite DART-MX8M
#@MAINTAINER: Felix Radensky <felix.r@variscite.com>
#
# http://www.variscite.com

require conf/machine/include/arm/arch-arm64.inc
require conf/machine/include/imx-base.inc

require generate_sdcard.inc
 
MACHINE_FEATURES += " pci wifi bluetooth"

MACHINEOVERRIDES =. "mx8:mx8mq:"
MACHINEOVERRIDES =. "imx:"

MACHINE_SOCARCH_FILTER_append_mx8mq = "virtual/libopenvg virtual/libgles1 virtual/libgles2 virtual/egl virtual/mesa virtual/libgl virtual/libg2d"

# Variscite BSP default providers
PREFERRED_PROVIDER_virtual/kernel_imx8m-var-dart ?= "linux-variscite"
PREFERRED_VERSION_linux-variscite = "4.9.51"

KERNEL_DEVICETREE = " \
	variscite/imx8m-var-dart-sd-emmc-hdmi.dtb \
	variscite/imx8m-var-dart-sd-emmc-hdmi-4k.dtb \
	variscite/imx8m-var-dart-sd-emmc-dcss-lvds.dtb \
	variscite/imx8m-var-dart-sd-emmc-lcdif-lvds.dtb \
	variscite/imx8m-var-dart-emmc-wifi-hdmi.dtb \
	variscite/imx8m-var-dart-emmc-wifi-hdmi-4k.dtb \
	variscite/imx8m-var-dart-emmc-wifi-dcss-lvds.dtb \	     
	variscite/imx8m-var-dart-emmc-wifi-lcdif-lvds.dtb \
"

KERNEL_IMAGETYPE_mx8 = "Image.gz"

IMAGE_M4LOADER = "imx-m4-demos"
IMAGE_M4 = "imx8mq_m4_TCM_hello_world.bin imx8mq_m4_TCM_rpmsg_lite_pingpong_rtos_linux_remote.bin imx8mq_m4_TCM_rpmsg_lite_str_echo_rtos.bin"

PREFERRED_PROVIDER_u-boot_imx8m-var-dart = "u-boot-variscite"
PREFERRED_PROVIDER_virtual/bootloader_imx8m-var-dart = "u-boot-variscite"

UBOOT_CONFIG ??= "sd"
UBOOT_CONFIG[sd] = "imx8m_var_dart_config,sdcard"
SPL_BINARY = "spl/u-boot-spl.bin"

# Set DDR FIRMWARE
DDR_FIRMWARE_NAME = "lpddr4_pmu_train_1d_imem.bin lpddr4_pmu_train_1d_dmem.bin lpddr4_pmu_train_2d_imem.bin lpddr4_pmu_train_2d_dmem.bin"

# Set u-boot DTB
UBOOT_DTB_NAME = "imx8m-var-dart.dtb"

# Set imx-mkimage boot target
IMXBOOT_TARGETS = "flash_evk flash_evk_no_hdmi"

SERIAL_CONSOLE = "115200 ttymxc0"

IMAGE_BOOTLOADER = "imx-boot"

SDCARD_GENERATION_COMMAND_mx8 = "generate_imx_sdcard_mx8"

DEFAULTTUNE_mx8 = "aarch64"

ROOTFS_SIZE = "3700"
LOADADDR = ""
UBOOT_SUFFIX = "bin"
UBOOT_MAKE_TARGET = ""
IMX_BOOT_SEEK = "33"

MACHINE_EXTRA_RDEPENDS += " \
			   linux-firmware-bcm4339 \
			   bcm43xx-utils \
			   brcm-patchram-plus \
			   kernel-modules \
			   hostapd \
			   iw \
			   wpa-supplicant \
			   packagegroup-tools-bluetooth \
			   pm-utils \
			   kmod \
			   hdparm \
			   gptfdisk \
			   u-boot-splash \
			   u-boot-fw-utils \
			   networkmanager \
			   "

BBMASK_prepend = "fsl-image-mfgtool-initramfs "

# Packages added to all images (including core-image-minimal)
IMAGE_INSTALL_append = " \
	fsl-rc-local \
	kernel-image \
	kernel-devicetree \
"

IMAGE_FSTYPES_imx8m-var-dart ?= "tar.gz sdcard.gz"
```

## conf/machine/imx8mm-var-dart.conf
```bitbake
#@TYPE: Machine
#@NAME: Variscite DART-MX8M-MINI
#@SOC: i.MX8MM
#@DESCRIPTION: Machine configuration for Variscite DART-MX8M-MINI and VAR-SOM-MX8M-MINI
#@MAINTAINER: Felix Radensky <felix.r@variscite.com>
#
# http://www.variscite.com

MACHINEOVERRIDES =. "mx8:mx8m:mx8mm:"
require conf/machine/include/imx-base.inc
require conf/machine/include/tune-cortexa53.inc

require variscite.inc
require variscite_bcm43xx.inc

KERNEL_DEVICETREE = " \
	freescale/imx8mm-var-dart.dtb \
	freescale/imx8mm-var-som.dtb \
	freescale/imx8mm-var-som-rev10.dtb \
	freescale/imx8mm-var-dart-m4.dtb \
	freescale/imx8mm-var-som-m4.dtb \
	freescale/imx8mm-var-som-rev10-m4.dtb \
"

IMAGE_BOOTFILES_DEPENDS += "imx-m4-demos:do_deploy"
IMAGE_BOOTFILES += "imx8mm_m4_TCM_hello_world.bin \
                    imx8mm_m4_TCM_rpmsg_lite_pingpong_rtos_linux_remote.bin \
                    imx8mm_m4_TCM_rpmsg_lite_str_echo_rtos.bin \
                    imx8mm_m4_TCM_sai_low_power_audio.bin \
"

UBOOT_CONFIG ??= "sd"
UBOOT_CONFIG[sd] = "imx8mm_var_dart_config,sdcard"
SPL_BINARY = "spl/u-boot-spl.bin"

# Set DDR FIRMWARE
DDR_FIRMWARE_NAME = " \
	ddr4_imem_1d.bin \
	ddr4_dmem_1d.bin \
	ddr4_imem_2d.bin \
	ddr4_dmem_2d.bin \
	lpddr4_pmu_train_1d_imem.bin \
	lpddr4_pmu_train_1d_dmem.bin \
	lpddr4_pmu_train_2d_imem.bin \
	lpddr4_pmu_train_2d_dmem.bin \
"
# Set U-Boot DTB
UBOOT_DTB_NAME = "imx8mm-var-dart.dtb"
UBOOT_DTB_EXTRA = "imx8mm-var-som.dtb imx8mm-var-som-rev10.dtb"

# Set imx-mkimage boot target
IMXBOOT_TARGETS = "flash_lpddr4_ddr4_evk"

SERIAL_CONSOLES = "115200;ttymxc0 115200;ttymxc3"

IMAGE_BOOTLOADER = "imx-boot"

ROOTFS_SIZE = "3700"
LOADADDR = ""
UBOOT_SUFFIX = "bin"
UBOOT_MAKE_TARGET = ""
IMX_BOOT_SEEK = "33"
```

## conf/machine/imx8mn-var-som.conf
```bitbake
#@TYPE: Machine
#@NAME: Variscite VAR-SOM-MX8M-NANO
#@SOC: i.MX8MN
#@DESCRIPTION: Machine configuration for Variscite VAR-SOM-MX8M-NANO
#@MAINTAINER: Felix Radensky <felix.r@variscite.com>
#
# http://www.variscite.com

MACHINEOVERRIDES =. "mx8:mx8m:mx8mn:"
require conf/machine/include/imx-base.inc
require conf/machine/include/arm/arch-arm64.inc

require variscite.inc

# Variscite BSP default providers
PREFERRED_PROVIDER_virtual/kernel_imx8mn-var-som ?= "linux-variscite"

KERNEL_DEVICETREE = " \
	freescale/imx8mn-var-som.dtb \
	freescale/imx8mn-var-som-rev10.dtb \
	freescale/imx8mn-var-som-m7.dtb \
	freescale/imx8mn-var-som-rev10-m7.dtb \
"

IMAGE_BOOTFILES_DEPENDS += "imx-m7-demos:do_deploy"
IMAGE_BOOTFILES += "imx8mn_m7_TCM_hello_world.bin \
                    imx8mn_m7_TCM_rpmsg_lite_pingpong_rtos_linux_remote.bin \
                    imx8mn_m7_TCM_rpmsg_lite_str_echo_rtos.bin \
                    imx8mn_m7_TCM_sai_low_power_audio.bin \
"

UBOOT_CONFIG ??= "sd"
UBOOT_CONFIG[sd] = "imx8mn_var_som_config,sdcard"
SPL_BINARY = "spl/u-boot-spl.bin"

# Set DDR FIRMWARE
DDR_FIRMWARE_NAME = " \
	ddr4_imem_1d_201810.bin \
	ddr4_dmem_1d_201810.bin \
	ddr4_imem_2d_201810.bin \
	ddr4_dmem_2d_201810.bin \
"

# Set U-Boot DTB
UBOOT_DTB_NAME = "fsl-imx8mn-var-som.dtb"
UBOOT_DTB_EXTRA = "fsl-imx8mn-var-som-rev10.dtb"

# Set imx-mkimage boot target
IMXBOOT_TARGETS = "flash_ddr4_evk"

SERIAL_CONSOLES = "115200;ttymxc3"

IMAGE_BOOTLOADER = "imx-boot"

ROOTFS_SIZE = "3700"
LOADADDR = ""
UBOOT_SUFFIX = "bin"
UBOOT_MAKE_TARGET = ""
IMX_BOOT_SEEK = "32"

PREFERRED_PROVIDER_u-boot_imx8mn-var-som = "u-boot-variscite"
PREFERRED_PROVIDER_virtual/bootloader_imx8mn-var-som = "u-boot-variscite"
```

## conf/machine/imx8mq-var-dart.conf
```bitbake
#@TYPE: Machine
#@NAME: Variscite DART-MX8M
#@SOC: i.MX8MQ
#@DESCRIPTION: Machine configuration for Variscite DART-MX8M
#@MAINTAINER: Felix Radensky <felix.r@variscite.com>
#
# http://www.variscite.com

MACHINEOVERRIDES =. "mx8:mx8m:mx8mq:"
require conf/machine/include/imx-base.inc
require conf/machine/include/tune-cortexa53.inc

require variscite.inc
require variscite_bcm43xx.inc

KERNEL_DEVICETREE = " \
	freescale/imx8mq-var-dart-dt8mcustomboard-wifi-dp.dtb \
	freescale/imx8mq-var-dart-dt8mcustomboard-wifi-hdmi.dtb \
	freescale/imx8mq-var-dart-dt8mcustomboard-wifi-lvds.dtb \
	freescale/imx8mq-var-dart-dt8mcustomboard-wifi-lvds-dp.dtb \
	freescale/imx8mq-var-dart-dt8mcustomboard-wifi-lvds-hdmi.dtb \
	freescale/imx8mq-var-dart-dt8mcustomboard-sd-dp.dtb \
	freescale/imx8mq-var-dart-dt8mcustomboard-sd-hdmi.dtb \
	freescale/imx8mq-var-dart-dt8mcustomboard-sd-lvds.dtb \
	freescale/imx8mq-var-dart-dt8mcustomboard-sd-lvds-dp.dtb \
	freescale/imx8mq-var-dart-dt8mcustomboard-sd-lvds-hdmi.dtb \
	freescale/imx8mq-var-dart-dt8mcustomboard-m4-wifi-dp.dtb \
	freescale/imx8mq-var-dart-dt8mcustomboard-m4-wifi-hdmi.dtb \
	freescale/imx8mq-var-dart-dt8mcustomboard-m4-wifi-lvds.dtb \
	freescale/imx8mq-var-dart-dt8mcustomboard-m4-wifi-lvds-dp.dtb \
	freescale/imx8mq-var-dart-dt8mcustomboard-m4-wifi-lvds-hdmi.dtb \
	freescale/imx8mq-var-dart-dt8mcustomboard-m4-sd-dp.dtb \
	freescale/imx8mq-var-dart-dt8mcustomboard-m4-sd-hdmi.dtb \
	freescale/imx8mq-var-dart-dt8mcustomboard-m4-sd-lvds.dtb \
	freescale/imx8mq-var-dart-dt8mcustomboard-m4-sd-lvds-dp.dtb \
	freescale/imx8mq-var-dart-dt8mcustomboard-m4-sd-lvds-hdmi.dtb \
	freescale/imx8mq-var-dart-dt8mcustomboard12-m4-sd-hdmi.dtb \
	freescale/imx8mq-var-dart-dt8mcustomboard12-m4-sd-lvds.dtb \
	freescale/imx8mq-var-dart-dt8mcustomboard12-m4-sd-lvds-hdmi.dtb \
	freescale/imx8mq-var-dart-dt8mcustomboard12-wifi-hdmi.dtb \
	freescale/imx8mq-var-dart-dt8mcustomboard12-wifi-lvds.dtb \
	freescale/imx8mq-var-dart-dt8mcustomboard12-wifi-lvds-hdmi.dtb \
	freescale/imx8mq-var-dart-dt8mcustomboard12-sd-hdmi.dtb \
	freescale/imx8mq-var-dart-dt8mcustomboard12-sd-lvds.dtb \
	freescale/imx8mq-var-dart-dt8mcustomboard12-sd-lvds-hdmi.dtb \
	freescale/imx8mq-var-dart-dt8mcustomboard12-m4-wifi-hdmi.dtb \
	freescale/imx8mq-var-dart-dt8mcustomboard12-m4-wifi-lvds.dtb \
	freescale/imx8mq-var-dart-dt8mcustomboard12-m4-wifi-lvds-hdmi.dtb \
"

IMAGE_BOOTFILES_DEPENDS += "imx-m4-demos:do_deploy"
IMAGE_BOOTFILES += "imx8mq_m4_TCM_hello_world.bin imx8mq_m4_TCM_rpmsg_lite_pingpong_rtos_linux_remote.bin imx8mq_m4_TCM_rpmsg_lite_str_echo_rtos.bin"

UBOOT_CONFIG ??= "sd"
UBOOT_CONFIG[sd] = "imx8mq_var_dart_config,sdcard"
SPL_BINARY = "spl/u-boot-spl.bin"

# Set DDR FIRMWARE
DDR_FIRMWARE_NAME = "lpddr4_pmu_train_1d_imem.bin lpddr4_pmu_train_1d_dmem.bin lpddr4_pmu_train_2d_imem.bin lpddr4_pmu_train_2d_dmem.bin"

# Set U-Boot DTB
UBOOT_DTB_NAME = "imx8mq-var-dart-customboard.dtb"

# Set imx-mkimage boot target
IMXBOOT_TARGETS = "flash_evk flash_evk_no_hdmi flash_dp_evk"

SERIAL_CONSOLES = "115200;ttymxc0"

IMAGE_BOOTLOADER = "imx-boot"

ROOTFS_SIZE = "3700"
LOADADDR = ""
UBOOT_SUFFIX = "bin"
UBOOT_MAKE_TARGET = ""
IMX_BOOT_SEEK = "33"
```
